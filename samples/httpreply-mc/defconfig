## samples/httpreply-mc/defconfig
```kconfig
CONFIG_ARCH_X86_64=y
CONFIG_PLAT_KVM=y
CONFIG_KVM_PCI=y
CONFIG_UKPLAT_CPU_MAXCOUNT=4
CONFIG_HAVE_SMP=y
CONFIG_LIBNOLIBC=y
CONFIG_LIBUKALLOC=y
CONFIG_LIBUKALLOCBBSID=y
CONFIG_LIBUKBUS=y
CONFIG_LIBUKBUS_PCI=y
CONFIG_LIBUKINTCTLR_APIC=y
CONFIG_LIBUKNETDEV=y
CONFIG_LIBUKNETDEV_MAXNBQUEUES=4
CONFIG_LIBUKSCHED=y
CONFIG_LIBUKSCHEDCOOP=y
CONFIG_LIBUKLOCK=y
CONFIG_LIBUKLOCK_SEMAPHORE=y
CONFIG_LIBUKLOCK_MUTEX=y
CONFIG_LIBUKMPI=y
CONFIG_LIBUKMPI_MBOX=y
CONFIG_LIBUKBOOT=y
CONFIG_LIBUKBOOT_PERCORE_HEAP=y
CONFIG_LIBUKBOOT_MAINTHREAD=y
CONFIG_LIBUKPCPUVAR=y
CONFIG_LIBLWIP=y
CONFIG_LWIP_IPV4=y
CONFIG_LWIP_TCP=y
CONFIG_LWIP_NOTHREADS=y
CONFIG_LWIP_PERCORE=y
CONFIG_LWIP_SOCKET=y
CONFIG_LWIP_DHCP=y
CONFIG_LWIP_AUTOIFACE=y
CONFIG_LWIP_NUM_TCPCON=1024
CONFIG_LWIP_NUM_TCPLISTENERS=256
CONFIG_LWIP_WND_SCALE=y
CONFIG_LWIP_RCVBUF=y
CONFIG_LWIP_POOLS=y
CONFIG_LIBPOSIX_POLL=y
CONFIG_LIBPOSIX_SOCKET=y
CONFIG_LIBPOSIX_SOCKET_POLLED=y
CONFIG_LIBPOSIX_TIME=y
CONFIG_LIBENA=y
CONFIG_LIBENA_LLQ=y
CONFIG_LIBENA_MAX_QUEUES=8
CONFIG_LIBENA_RSS=y
CONFIG_LIBENA_VERBOSE_STATS=n
CONFIG_LIBUKPRINT_KLVL_INFO=y
CONFIG_APPHTTPREPLYMC=y
CONFIG_APPHTTPREPLYMC_CONSOLE_STATS=n

# Build optimization for the c6i benchmark target.
CONFIG_OPTIMIZE_PERF=y
CONFIG_OPTIMIZE_LTO=y
```

## samples/httpreply/defconfig
```kconfig
CONFIG_ARCH_X86_64=y
CONFIG_PLAT_KVM=y
CONFIG_KVM_PCI=y
CONFIG_LIBNOLIBC=y
CONFIG_LIBUKALLOC=y
CONFIG_LIBUKALLOCBBSID=y
CONFIG_LIBUKBUS=y
CONFIG_LIBUKBUS_PCI=y
CONFIG_LIBUKNETDEV=y
CONFIG_LIBLWIP=y
CONFIG_LWIP_IPV4=y
CONFIG_LWIP_TCP=y
CONFIG_LWIP_NOTHREADS=y
CONFIG_LWIP_SOCKET=y
CONFIG_LWIP_DHCP=y
CONFIG_LWIP_AUTOIFACE=y
CONFIG_LWIP_NUM_TCPCON=1024
CONFIG_LWIP_NUM_TCPLISTENERS=256
CONFIG_LWIP_WND_SCALE=y
CONFIG_LWIP_RCVBUF=y
CONFIG_LWIP_POOLS=y
CONFIG_LIBPOSIX_POLL=y
CONFIG_LIBPOSIX_SOCKET_POLLED=y
CONFIG_LIBPOSIX_TIME=y
CONFIG_LIBENA=y
CONFIG_LIBENA_LLQ=y
CONFIG_APPHTTPREPLY=y
```
